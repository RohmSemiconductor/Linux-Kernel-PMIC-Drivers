## Documentation/devicetree/bindings/mfd/rohm,bd96811-pmic.yaml
```yaml
# SPDX-License-Identifier: GPL-2.0-only OR BSD-2-Clause
%YAML 1.2
---
$id: http://devicetree.org/schemas/mfd/rohm,bd96811-pmic.yaml#
$schema: http://devicetree.org/meta-schemas/core.yaml#

title: ROHM BD96811 Scalable Power Management Integrated Circuit

maintainers:
  - Matti Vaittinen <matti.vaittinen@fi.rohmeurope.com>

description: |
  BD96811 is an automotive grade configurable Power Management Integrated
  Circuit supporting Functional Safety features for application
  processors, SoCs and FPGAs

properties:
  compatible:
    const: rohm,bd96811

  reg:
    description:
      I2C slave address.
    maxItems: 1

  rohm,protect-enable:
    type: boolean
    description:
      Hardware shuts off the regulator outputs if under/over voltage, over
      current or thermal warning limits are exceeded.

  interrupts:
    description:
      The PMIC may have one of the DOUT pins configured to operate as an
      IRQ line by OTP configuration.
    maxItems: 1

  interrupt-names:
    const: intb

  rohm,adc0-enabled:
    type: boolean
    description:
      Property to indicate that BD96811 DOUT3 pin is configured as ADC0
      input by OTP.

  "#io-channel-cells":
    const: 1
  "#address-cells":
    const: 1
  "#size-cells":
    const: 0

  regulators:
    $ref: ../regulator/rohm,bd96811-regulator.yaml
    description:
      List of child nodes that specify the regulators.

  pin-settings:
    type: object
    description:
      Subnode containing the default settings. It contains an arbitrary number
      of configuration subnodes, one for each group or pin configuration you
      want to apply as a default.
    patternProperties:
      '-pins$':
        $ref: ../pinctrl/pinmux-node.yaml
        type: object
        properties:
          groups:
            enum:
              - adc1
              - adc2
              - din4
              - dout4

          function:
            enum:
              - adc1
              - adc2
              - din4
              - dout4

patternProperties:
  "^channel@[0-2]+$":
    type: object
    $ref: ../iio/adc/adc.yaml#
    description: Represents each of the external channels which are
      connected to the ADC.

    properties:
      reg:
        items:
          maximum: 2

    required:
      - reg

    additionalProperties: false

required:
  - compatible
  - reg
  - regulators

additionalProperties: false

examples:
  - |
    #include <dt-bindings/interrupt-controller/irq.h>
    #include <dt-bindings/leds/common.h>
    i2c {
        #address-cells = <1>;
        #size-cells = <0>;
        pmic: pmic@60 {
            reg = <0x60>;
            compatible = "rohm,bd96811";
            interrupt-parent = <&gpio1>;
            interrupts = <29 IRQ_TYPE_LEVEL_LOW>;
            rohm,protect-enable;
            #io-channel-cells = <1>;
            #address-cells = <1>;
            #size-cells = <0>;

            pinctrl-names = "default";
            pinctrl-0 = <&bd96811_pins>;

            bd96811_pins: pin-settings {
                    adc1-pins {
                            groups = "adc1";
                            function = "adc1";
                    };
            };
            adc1: channel@1 {
                    reg = <1>;
            };

            regulators {
                vout1: vout1 {
                    regulator-name = "vout1";
                    regulator-ramp-delay = <4500>;
                    rohm,regulator-type = <1>;
                };
                vout2: vout2 {
                    regulator-name = "vout2";
                    regulator-ramp-delay = <4500>;
                    rohm,regulator-type = <1>;
                };
                vout3: vout3 {
                    regulator-name = "vout3";
                    regulator-ramp-delay = <4500>;
                    rohm,regulator-type = <1>;
                };
                vout4: vout4 {
                    regulator-name = "vout4";
                    regulator-ramp-delay = <4500>;
                    rohm,regulator-type = <1>;
                };
                vout5: vout5 {
                    regulator-name = "vout5";
                    regulator-ramp-delay = <4500>;
                    rohm,regulator-type = <3>;
                };
            };
        };
    };
```

## Documentation/devicetree/bindings/regulator/rohm,bd2657-regulator.yaml
```yaml
# SPDX-License-Identifier: GPL-2.0-only OR BSD-2-Clause
%YAML 1.2
---
$id: http://devicetree.org/schemas/regulator/rohm,bd2657-regulator.yaml#
$schema: http://devicetree.org/meta-schemas/core.yaml#

title: ROHM BD2657 Power Management Integrated Circuit regulators

maintainers:
  - Matti Vaittinen <matti.vaittinen@fi.rohmeurope.com>

description: |
  This module is part of the ROHM BD2657 MFD device. For more details
  see Documentation/devicetree/bindings/mfd/rohm,bd2657-pmic.yaml.

  The regulator controller is represented as a sub-node of the PMIC node
  on the device tree.

  Regulator nodes should be named to BUCK_<number> and LDO_<number>.
  The valid names for BD2657 regulator nodes are
  buck0, buck1, buck2, buck3

patternProperties:
  "^buck[0-3]$":
    type: object
    description:
      Properties for single buck regulator.
    $ref: regulator.yaml#

    properties:
      regulator-name:
        pattern: "^buck[0-3]$"
        description:
          should be "buck0", ..., "buck3"

    required:
      - regulator-name

    unevaluatedProperties: false

additionalProperties: false
```

## Documentation/devicetree/bindings/regulator/rohm,bd96801-regulator.yaml
```yaml
# SPDX-License-Identifier: GPL-2.0-only OR BSD-2-Clause
%YAML 1.2
---
$id: http://devicetree.org/schemas/regulator/rohm,bd96801-regulator.yaml#
$schema: http://devicetree.org/meta-schemas/core.yaml#

title: ROHM BD96801 Power Management Integrated Circuit regulators

maintainers:
  - Matti Vaittinen <matti.vaittinen@fi.rohmeurope.com>

description: |
  This module is part of the ROHM BD96801 MFD device. For more details
  see Documentation/devicetree/bindings/mfd/rohm,bd96801-pmic.yaml.

  The regulator controller is represented as a sub-node of the PMIC node
  on the device tree.

  Regulator nodes should be named to BUCK_<number> and LDO_<number>.
  The valid names for BD96801 regulator nodes are
  BUCK1, BUCK2, BUCK3, BUCK4, LDO5, LDO6, LDO7

patternProperties:
  "^LDO[5-7]$":
    type: object
    allOf:
      - $ref: regulator.yaml#
    description:
      Properties for single LDO regulator.

    properties:
      regulator-name:
        pattern: "^ldo[5-7]$"
        description:
          should be "ldo5", ..., "ldo7"
      rohm,initial-voltage-microvolt:
        description:
          Initial voltage for regulator. Voltage can be tuned +/-150 mV from
          this value. NOTE, This can be modified via I2C only when PMIC is in
          STBY state.
        minimum: 300000
        maximum: 3300000
      # Please note: The safety limits for BD96801 can be changed only when
      # the PMIC is in STBY state.
      regulator-ov-error-microvolt:
      regulator-ov-warn-microvolt:
      regulator-uv-error-microvolt:
      regulator-uv-warn-microvolt:
      regulator-temp-protection-kelvin:
      regulator-temp-error-kelvin:
      regulator-temp-warn-kelvin:

  "^BUCK[1-4]$":
    type: object
    allOf:
      - $ref: regulator.yaml#
    description:
      Properties for single BUCK regulator.

    properties:
      regulator-name:
        pattern: "^buck[1-4]$"
        description:
          should be "buck1", ..., "buck4"
      rohm,initial-voltage-microvolt:
        description:
          Initial voltage for regulator. Voltage can be tuned +/-150 mV from
          this value. NOTE, This can be modified via I2C only when PMIC is in
          STBY state.
        minimum: 500000
        maximum: 3300000
      rohm,keep-on-stby:
        description:
          Keep the regulator powered when PMIC transitions to STBY state.
        type: boolean

    required:
      - regulator-name
  additionalProperties: false
additionalProperties: false
```

## Documentation/devicetree/bindings/regulator/rohm,bd96802-regulator.yaml
```yaml
# SPDX-License-Identifier: GPL-2.0-only OR BSD-2-Clause
%YAML 1.2
---
$id: http://devicetree.org/schemas/regulator/rohm,bd96802-regulator.yaml#
$schema: http://devicetree.org/meta-schemas/core.yaml#

title: ROHM BD96802 Power Management Integrated Circuit regulators

maintainers:
  - Matti Vaittinen <matti.vaittinen@fi.rohmeurope.com>

description: |
  This module is part of the ROHM BD96802 MFD device. For more details
  see Documentation/devicetree/bindings/mfd/rohm,bd96802-pmic.yaml.

  The regulator controller is represented as a sub-node of the PMIC node
  on the device tree.

  Regulator nodes should be named to BUCK_1 and BUCK_2.

patternProperties:
  "^BUCK[1-2]$":
    type: object
    allOf:
      - $ref: regulator.yaml#
    description:
      Properties for single BUCK regulator.

    properties:
      regulator-name:
        pattern: "^buck[1-2]$"
        description:
          should be "buck1" and "buck2"
      rohm,initial-voltage-microvolt:
        description:
          Initial voltage for regulator. Voltage can be tuned +/-150 mV from
          this value. NOTE, This can be modified via I2C only when PMIC is in
          STBY state.
        minimum: 500000
        maximum: 3300000
      rohm,keep-on-stby:
        description:
          Keep the regulator powered when PMIC transitions to STBY state.
        type: boolean

    required:
      - regulator-name
  additionalProperties: false
additionalProperties: false
```

## Documentation/devicetree/bindings/regulator/rohm,bd96811-regulator.yaml
```yaml
# SPDX-License-Identifier: GPL-2.0-only OR BSD-2-Clause
%YAML 1.2
---
$id: http://devicetree.org/schemas/regulator/rohm,bd96811-regulator.yaml#
$schema: http://devicetree.org/meta-schemas/core.yaml#

title: ROHM BD96811 Power Management Integrated Circuit regulators

maintainers:
  - Matti Vaittinen <matti.vaittinen@fi.rohmeurope.com>

description: |
  This module is part of the ROHM BD96811 MFD device. For more details
  see Documentation/devicetree/bindings/mfd/rohm,bd96811-pmic.yaml.

  The regulator controller is represented as a sub-node of the PMIC node
  on the device tree.

  The valid names for BD96811 regulator nodes are
  vout1, vout2, ..., vout5.

properties:
  vout1:
    type: object
    description:
      properties for vout1 regulator
    $ref: regulator.yaml#
    unevaluatedProperties: false

    properties:
      regulator-name:
        const: vout1

      rohm,regulator-type:
        $ref: "/schemas/types.yaml#/definitions/uint32"
        description:
          The BD96811 may have dfifferent types of regulator regulators
          depending on OTP option. Indicate type of regulator by assigning
          the type to 1 (BUCK), 2 (BOOST) or 3 (LDO) to match your PMIC.
        #VOUT1 is always BUCK.
        const: 1
      rohm,uvd-base-microvolt:
        description:
          The BD96811 has a default limit for the under-voltage detection
          configured by OTP. Provide limit matching OTP on the IC as
          offset from the target output voltage.
      rohm,ovd-base-microvolt:
        description:
          The BD96811 has a default limit for the over-voltage detection
          configured by OTP. Provide limit matching OTP on the IC as
          offset from the target output voltage.

  vout2:
    type: object
    description:
      properties for vout2 regulator
    $ref: regulator.yaml#
    unevaluatedProperties: false

    properties:
      regulator-name:
        const: vout2

      rohm,regulator-type:
        description:
          The BD96811 may have dfifferent types of regulator regulators
          depending on OTP option. Indicate type of regulator by assigning
          the type to 1 (BUCK), 2 (BOOST) or 3 (LDO) to match your PMIC.
        $ref: "/schemas/types.yaml#/definitions/uint32"
        #VOUT1 is BUCK or BOOST.
        minimum: 1
        maximum: 2

  vout3:
    type: object
    description:
      properties for vout3 regulator
    $ref: regulator.yaml#
    unevaluatedProperties: false

    properties:
      regulator-name:
        const: vout3

      rohm,regulator-type:
        description:
          The BD96811 may have dfifferent types of regulator regulators
          depending on OTP option. Indicate type of regulator by assigning
          the type to 1 (BUCK), 2 (BOOST) or 3 (LDO) to match your PMIC.
        $ref: "/schemas/types.yaml#/definitions/uint32"
        #VOUT3 is BUCK or LDO.
        items:
          - const: 1
          - const: 3
        maxItems: 1

  vout4:
    type: object
    description:
      properties for vout4 regulator
    $ref: regulator.yaml#
    unevaluatedProperties: false

    properties:
      regulator-name:
        const: vout4

      rohm,regulator-type:
        description:
          The BD96811 may have dfifferent types of regulator regulators
          depending on OTP option. Indicate type of regulator by assigning
          the type to 1 (BUCK), 2 (BOOST) or 3 (LDO) to match your PMIC.
        $ref: "/schemas/types.yaml#/definitions/uint32"
        #VOUT4 is BUCK or LDO.
        items:
          - const: 1
          - const: 3
        maxItems: 1

  vout5:
    type: object
    description:
      properties for vout2 regulator
    $ref: regulator.yaml#
    unevaluatedProperties: false

    properties:
      regulator-name:
        const: vout5

      rohm,regulator-type:
        description:
          The BD96811 may have dfifferent types of regulator regulators
          depending on OTP option. Indicate type of regulator by assigning
          the type to 1 (BUCK), 2 (BOOST) or 3 (LDO) to match your PMIC.
        $ref: "/schemas/types.yaml#/definitions/uint32"
        #VOUT5 is LDO.
        const: 3

    required:
      - regulator-name
      - rohm,regulator-type

    unevaluatedProperties: false

additionalProperties: false
```

## drivers/mva-overlay/Kconfig
```kconfig
# SPDX-License-Identifier: GPL-2.0
config MVA_OVERLAY
	tristate "Overlay DT blobs for few tests"
	help
	  Compile overlay blobs for few tests. (simple-gauge, few IC drivers).

	  If unsure, say no.

source "drivers/mva-overlay/overlay_dts/Kconfig"
```

## drivers/mva-overlay/overlay_dts/Kconfig
```kconfig
#menuconfig MVA_DT_OVERLAY_BLOBS
#	bool  "Device overlay blobs"
#	depends on MVA_OVERLAY
#	help
#	  Build DT overlay binary blobs.
#
#	  These device-tree overlay blobs are intended to be used for
#	  testing.
#
#if MVA_DT_OVERLAY_BLOBS
config MVA_OVERLAY_BD71815_SIMPLE_GAUGE_TEST
	bool "Dummy device node for BD71815 test"
	depends on MVA_OVERLAY
	help
	  DT blob to allow testing of BD71815 driver and the simple-gauge

	  If unsure, say no.

#endif
```
