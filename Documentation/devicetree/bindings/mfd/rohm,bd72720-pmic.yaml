## Documentation/devicetree/bindings/mfd/rohm,bd72720-pmic.yaml
```yaml
# SPDX-License-Identifier: GPL-2.0-only OR BSD-2-Clause
%YAML 1.2
---
$id: http://devicetree.org/schemas/mfd/rohm,bd72720-pmic.yaml#
$schema: http://devicetree.org/meta-schemas/core.yaml#

title: ROHM BD72720 Power Management Integrated Circuit

maintainers:
  - Matti Vaittinen <mazziesaccount@gmail.com>

description: |
  BD72720 is a single-chip power management IC for battery-powered portable
  devices. The BD72720 integrates 10 bucks and 11 LDOs, and a 3000 mA
  switching charger. The IC also includes a Coulomb counter, a real-time
  clock (RTC), GPIOs and a 32.768 kHz clock gate.

properties:
  compatible:
    const: rohm,bd72720

  reg:
    description:
      I2C slave address.
    maxItems: 1

  interrupts:
    maxItems: 1

  gpio-controller: true

  "#gpio-cells":
    const: 2
    description: |
      The first cell is the pin number and the second cell is used to specify
      flags. See ../gpio/gpio.txt for more information.

  clocks:
    maxItems: 1

  "#clock-cells":
    const: 0

  clock-output-names:
    const: bd71828-32k-out

  rohm,clkout-open-drain:
    description: clk32kout mode. Set to 1 for "open-drain" or 0 for "cmos".
    $ref: /schemas/types.yaml#/definitions/uint32
    minimum: 0
    maximum: 1

  rohm,charger-sense-resistor-milli-ohms:
    minimum: 10
    maximum: 50
    description: |
      BD72720 has a SAR ADC for measuring charging currents. External sense
      resistor (RSENSE in data sheet) should be used. If some other but
      30 mOhm resistor is used the resistance value should be given here in
      milli Ohms.

  regulators:
    $ref: ../regulator/rohm,bd77270-regulator.yaml
    description:
      List of child nodes that specify the regulators.

  leds:
    $ref: ../leds/rohm,bd71828-leds.yaml

  rohm,pin-dvs0:
    $ref: /schemas/types.yaml#/definitions/string
    description:
      BD72720 has 4 different OTP options to determine the use of dvs0-pin.
      OTP0 - regulator RUN state control.
      OTP1 - GPI.
      OTP2 - GPO.
      OTP3 - Power sequencer output.
      This property specifies the use of the pin.
    enum:
      - dvs-input
      - gpi
      - gpo

  rohm,pin-dvs1:
    $ref: /schemas/types.yaml#/definitions/string
    description:
      see rohm,pin-dvs0
    enum:
      - dvs-input
      - gpi
      - gpo

  rohm,pin-exten0:
    $ref: /schemas/types.yaml#/definitions/string
    description: BD72720 has an OTP option to use exten0-pin for different
      purposes. Set this property accrdingly.
    const: gpo

  rohm,pin-exten1:
    $ref: /schemas/types.yaml#/definitions/string
    description: BD72720 has an OTP option to use exten1-pin for different
      purposes. Set this property accrdingly.
    const: gpo

  rohm,pin-fault_b:
    $ref: /schemas/types.yaml#/definitions/string
    description: BD72720 has an OTP option to use fault_b-pin for different
      purposes. Set this property accrdingly.
    const: gpo

required:
  - compatible
  - reg
  - interrupts
  - clocks
  - "#clock-cells"
  - regulators
  - gpio-controller
  - "#gpio-cells"

additionalProperties: false

examples:
  - |
    #include <dt-bindings/interrupt-controller/irq.h>
    #include <dt-bindings/leds/common.h>
    i2c {
        #address-cells = <1>;
        #size-cells = <0>;
        pmic: pmic@4b {
            compatible = "rohm,bd71828";
            reg = <0x4b>;

            interrupt-parent = <&gpio1>;
            interrupts = <29 IRQ_TYPE_LEVEL_LOW>;

            clocks = <&osc 0>;
            #clock-cells = <0>;
            clock-output-names = "bd71828-32k-out";

            gpio-controller;
            #gpio-cells = <2>;
            gpio-reserved-ranges = <0 1>, <2 1>;

            rohm,charger-sense-resistor-ohms = <10000000>;

            regulators {
                buck1: BUCK1 {
                    regulator-name = "buck1";
                    regulator-min-microvolt = <500000>;
                    regulator-max-microvolt = <2000000>;
                    regulator-ramp-delay = <2500>;
                };
                buck2: BUCK2 {
                    regulator-name = "buck2";
                    regulator-min-microvolt = <500000>;
                    regulator-max-microvolt = <2000000>;
                    regulator-ramp-delay = <2500>;
                };
                buck3: BUCK3 {
                    regulator-name = "buck3";
                    regulator-min-microvolt = <1200000>;
                    regulator-max-microvolt = <2000000>;
                };
                buck4: BUCK4 {
                    regulator-name = "buck4";
                    regulator-min-microvolt = <1000000>;
                    regulator-max-microvolt = <1800000>;
                };
                buck5: BUCK5 {
                    regulator-name = "buck5";
                    regulator-min-microvolt = <2500000>;
                    regulator-max-microvolt = <3300000>;
                };
                buck6: BUCK6 {
                    regulator-name = "buck6";
                    regulator-min-microvolt = <500000>;
                    regulator-max-microvolt = <2000000>;
                    regulator-ramp-delay = <2500>;
                };
                buck7: BUCK7 {
                    regulator-name = "buck7";
                    regulator-min-microvolt = <500000>;
                    regulator-max-microvolt = <2000000>;
                    regulator-ramp-delay = <2500>;
                };
                ldo1: LDO1 {
                    regulator-name = "ldo1";
                    regulator-min-microvolt = <800000>;
                    regulator-max-microvolt = <3300000>;
                };
                ldo2: LDO2 {
                    regulator-name = "ldo2";
                    regulator-min-microvolt = <800000>;
                    regulator-max-microvolt = <3300000>;
                };
                ldo3: LDO3 {
                    regulator-name = "ldo3";
                    regulator-min-microvolt = <800000>;
                    regulator-max-microvolt = <3300000>;
                };
                ldo4: LDO4 {
                    regulator-name = "ldo4";
                    regulator-min-microvolt = <800000>;
                    regulator-max-microvolt = <3300000>;
                };
                ldo5: LDO5 {
                    regulator-name = "ldo5";
                    regulator-min-microvolt = <800000>;
                    regulator-max-microvolt = <3300000>;
                };
                ldo6: LDO6 {
                    regulator-name = "ldo6";
                    regulator-min-microvolt = <1800000>;
                    regulator-max-microvolt = <1800000>;
                };
                ldo7_reg: LDO7 {
                    regulator-name = "ldo7";
                    regulator-min-microvolt = <800000>;
                    regulator-max-microvolt = <3300000>;
                };
            };

            leds {
                compatible = "rohm,bd71828-leds";

                led-1 {
                    rohm,led-compatible = "bd71828-grnled";
                    function = LED_FUNCTION_INDICATOR;
                    color = <LED_COLOR_ID_GREEN>;
                };
                led-2 {
                    rohm,led-compatible = "bd71828-ambled";
                    function = LED_FUNCTION_CHARGING;
                    color = <LED_COLOR_ID_AMBER>;
                };
            };
        };
    };
```

## Documentation/devicetree/bindings/mfd/rohm,bd96801-pmic.yaml
```yaml
# SPDX-License-Identifier: GPL-2.0-only OR BSD-2-Clause
%YAML 1.2
---
$id: http://devicetree.org/schemas/mfd/rohm,bd96801-pmic.yaml#
$schema: http://devicetree.org/meta-schemas/core.yaml#

title: ROHM BD96801 Scalable Power Management Integrated Circuit

maintainers:
  - Matti Vaittinen <matti.vaittinen@fi.rohmeurope.com>

description: |
  BD96801 is an automotive grade single-chip power management IC.
  It integrates 4 buck converters and 3 LDOs with safety features like
  over-/under voltage and over current detection and a watchdog.

properties:
  compatible:
    const: rohm,bd96801

  reg:
    description:
      I2C slave address.
    maxItems: 1

  interrupts:
    description:
      The PMIC provides intb and errb IRQ lines. The errb IRQ line is used
      for fatal IRQs which will cause the PMIC to shut down power outputs.
      In many systems this will shut down the SoC contolling the PMIC and
      connecting/handling the errb can be omitted. However, there are cases
      where the SoC is not powered by the PMIC. In that case it may be
      useful to connect the errb and handle errb events.
    minItems: 1
    maxItems: 2

  interrupt-names:
    minItems: 1
    items:
      - enum: [intb, errb]
      - const: errb

  rohm,hw-timeout-ms:
    description:
      Watchdog timeout value(s). First walue is timeout limit. Second value is
      optional value for 'too early' watchdog ping if window timeout mode is
      to be used.
    minItems: 1
    maxItems: 2

  rohm,wdg-action:
    description:
      Whether the watchdog failure must turn off the regulator power outputs or
      just toggle the INTB line.
    enum:
      - prstb
      - intb-only

  regulators:
    $ref: ../regulator/rohm,bd96801-regulator.yaml
    description:
      List of child nodes that specify the regulators.

required:
  - compatible
  - reg
  - interrupts
  - interrupt-names
  - regulators

additionalProperties: false

examples:
  - |
    #include <dt-bindings/interrupt-controller/irq.h>
    #include <dt-bindings/leds/common.h>
    i2c {
        #address-cells = <1>;
        #size-cells = <0>;
        bdpmic: pmic@60 { /* the "test" defined as child of the i2c1 bus */
            reg = <0x60>;
            compatible = "rohm,bd96801";
            interrupt-parent = <&gpio1>;
            interrupts = <29 8 6 8>;
            interrupt-names = "intb", "errb";

            regulators {
                buck1: BUCK1 {
                    regulator-name = "buck1";
                    /* This can be set only when PMIC is in STBY */
                    rohm,initial-voltage-microvolt = <500000>;

                    regulator-ramp-delay = <1250>;
                    /* 0.5V min INITIAL - 150 mV tune */
                    regulator-min-microvolt = <350000>;
                    /* 3.3V + 150mV tune */
                    regulator-max-microvolt = <3450000>;

                    /* Also these can be set only when PMIC is in STBY */
                    regulator-ov-error-microvolt = <230000>;
                    regulator-uv-error-microvolt = <230000>;
                    regulator-temp-protection-kelvin = <1>;
                    regulator-temp-warn-kelvin = <0>;
                };
                buck2: BUCK2 {
                    regulator-name = "buck2";
                    rohm,initial-voltage-microvolt = <3000000>;
                    regulator-min-microvolt = <350000>;
                    regulator-max-microvolt = <3450000>;
                    regulator-ov-error-microvolt = <18000>;
                    regulator-uv-error-microvolt = <18000>;
                    regulator-temp-protection-kelvin = <1>;
                    regulator-temp-warn-kelvin = <1>;
                };
                buck3: BUCK3 {
                    regulator-name = "buck3";

                    rohm,initial-voltage-microvolt = <600000>;
                    regulator-min-microvolt = <350000>;
                    regulator-max-microvolt = <3450000>;

                    regulator-ov-warn-microvolt = <18000>;
                    regulator-uv-warn-microvolt = <18000>;
                    regulator-temp-protection-kelvin = <1>;
                    regulator-temp-error-kelvin = <0>;
                };
                buck4: BUCK4 {
                    regulator-name = "buck4";

                    rohm,initial-voltage-microvolt = <600000>;
                    regulator-min-microvolt = <350000>;
                    regulator-max-microvolt = <3450000>;

                    regulator-ov-warn-microvolt = <18000>;
                    regulator-uv-warn-microvolt = <18000>;
                    regulator-temp-protection-kelvin = <1>;
                    regulator-temp-error-kelvin = <0>;
                };
                ldo5: LDO5 {
                    regulator-name = "ldo5";

                    rohm,initial-voltage-microvolt = <500000>;
                    regulator-min-microvolt = <300000>;
                    regulator-max-microvolt = <3300000>;

                    regulator-ov-error-microvolt = <36000>;
                    regulator-uv-error-microvolt = <34000>;
                    regulator-temp-protection-kelvin = <1>;
                    regulator-temp-warn-kelvin = <0>;
                };
                ldo6: LDO6 {
                    regulator-name = "ldo6";

                    rohm,initial-voltage-microvolt = <300000>;

                    regulator-min-microvolt = <300000>;
                    regulator-max-microvolt = <3300000>;

                    regulator-ov-error-microvolt = <36000>;
                    regulator-uv-error-microvolt = <34000>;
                    regulator-temp-protection-kelvin = <1>;
                    regulator-temp-warn-kelvin = <0>;
                };
                ldo7: LDO7 {
                    regulator-name = "ldo7";

                    rohm,initial-voltage-microvolt = <500000>;
                    regulator-min-microvolt = <300000>;
                    regulator-max-microvolt = <3300000>;

                    regulator-ov-error-microvolt = <36000>;
                    regulator-uv-error-microvolt = <34000>;
                    regulator-temp-protection-kelvin = <1>;
                    regulator-temp-warn-kelvin = <0>;
                };
            };
        };
    };
```
